## boards/shields/handwired_fspring/Kconfig.shield
```kconfig
# Copyright (c) 2021 The ZMK Contributors
# SPDX-License-Identifier: MIT

config SHIELD_HANDWIRED_FSPRING
    def_bool $(shields_list_contains,handwired_fspring)
```
